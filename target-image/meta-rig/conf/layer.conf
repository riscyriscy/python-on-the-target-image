## target-image/meta-rig/conf/layer.conf
```bitbake
BBPATH .= ":${LAYERDIR}"
BBFILES += "${LAYERDIR}/recipes-*/*/*.bb ${LAYERDIR}/recipes-*/*/*.bbappend"
BBFILE_COLLECTIONS += "rig"
BBFILE_PATTERN_rig = "^${LAYERDIR}/"
BBFILE_PRIORITY_rig = "10"
LAYERSERIES_COMPAT_rig = "scarthgap"
LAYERDEPENDS_rig = "core"
```
